## config/west.yml
```yaml
manifest:
  remotes:
    - name: zmkfirmware
      url-base: https://github.com/zmkfirmware
    - name: marco
      url-base: https://github.com/somethingpolo
    - name: kevinpastor
      url-base: https://github.com/kevinpastor
  projects:
    - name: zmk
      remote: zmkfirmware
      revision: v0.3
      import: app/west.yml
    - name: polo-zmk-peripheral-animation
      remote: marco
      revision: main
    - name: nice-view-elemental
      remote: kevinpastor
      revision: main
  self:
    path: config
```
